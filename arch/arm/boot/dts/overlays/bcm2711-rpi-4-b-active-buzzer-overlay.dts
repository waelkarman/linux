/dts-v1/;
/plugin/;

/ {
    compatible = "brcm,bcm2711";

    fragment@0 {
        target-path = "/";
        __overlay__ {
            active_buzzer {
                compatible = "bunchlinux,active-buzzer";
                gpios = <&gpio 17 0>;  // GPIO_ACTIVE_HIGH = 0
                status = "okay";
            };
        };
    };
};