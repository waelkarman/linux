## drivers/platform/bunch_linux/active_buzzer/Kconfig
```kconfig
config ACTIVE_BUZZER
    tristate "GPIO Active Buzzer driver"
    default M
    help
      Simple GPIO Active Buzzer driver for Raspberry Pi 4
      Reads the buzzer GPIO from the device tree and exposes
      /dev/active-buzzer character device.
```

## drivers/platform/bunch_linux/buzzer/Kconfig
```kconfig
config BUZZER
    tristate "GPIO Buzzer driver"
    default M
    help
      Simple GPIO Buzzer driver for Raspberry Pi 4
      Reads the buzzer GPIO from the device tree and exposes
      /dev/my-buzzer character device.
```

## drivers/platform/bunch_linux/passive_buzzer/Kconfig
```kconfig
config BUZZER
    tristate "PWM Passive Buzzer driver"
    default M
    help
      Simple PWM Passive Buzzer driver for Raspberry Pi 4
      Reads the buzzer PWM from the device tree and exposes
      /dev/passive-buzzer character device.
```
